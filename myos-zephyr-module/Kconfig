## myos-zephyr-module/Kconfig
```kconfig
# Main switch for MyOs Module

menuconfig MYOS
  bool "Enable MyOs cooperative scheduler"
  help
    Activates the MyOs-Subsystem, which executes a 
    cooperative Protothread-Schedler in a Zephyr-Thread
    

if MYOS

config MYOS_STATISTICS
    bool "Enable MyOS runtime statistics"
    default n
    help
      Enables collection and output of MyOS runtime statistics.
      If disabled, all statistics-related calls are compiled out.

config MYOS_STACK_SIZE
  int "Size of stack for the MyOs-Thread"
  default 2048
  range 256 65535 
  help
    Size of stack in bytes for the Zephyr thread in which MyOS runs.

config MYOS_PROC_EVENT_QUEUE_SIZE
    int "Size of the MyOS process event queue"
    default 85
    range 1 65535
    help
      Size of the process event queue used by MyOS.
    
config MYOS_THREAD_PRIORITY
  int "Priority of the MyOs-Thread"
  default 0
  help 
    Zephir-Thread-Priority for MyOs
    Small Number = high priority (depending on Kernel-Configuration)

# Select the process list type MyOS should use
choice MYOS_PROC_LIST_TYPE
    prompt "Process list type"
    help
      Choose which internal list type MyOS should use for storing processes.

config MYOS_PROC_LIST_TYPE_SLIST
    bool "Singly-linked list"

config MYOS_PROC_LIST_TYPE_DLIST
    bool "Doubly-linked list"

endchoice

# Select the list type used for ptimers
choice MYOS_PTIMER_LIST_TYPE
    prompt "PTimer list type"
    help
      Choose which internal list type MyOS should use for
      storing ptimers.

config MYOS_PTIMER_LIST_TYPE_SLIST
    bool "Singly-linked list"

config MYOS_PTIMER_LIST_TYPE_DLIST
    bool "Doubly-linked list"

endchoice


config MYOS_TIMESTAMP_SIZE
    int "MyOS timestamp size (bits)"
    default 16
    range 16 64
    help
      Valid values: 16, 32, 64

config MYOS_DEBUG
  bool "Enable MyOs debug output"
  default n
  help
    Enables debug output for MyOs.
    If disabled, all MyOs debug calls are compiled out.

config MYOS_DEBUG_PROCESS
  bool "Debug: process module"
  depends on MYOS_DEBUG
  default n
  help
    Enable debug output for the MyOs process module.

config MYOS_DEBUG_ETIMER
  bool "Debug: etimer module"
  depends on MYOS_DEBUG
  default n
  help
    Enable debug output for the MyOs etimer module.

config MYOS_DEBUG_PTIMER
  bool "Debug: ptimer module"
  depends on MYOS_DEBUG
  default n
  help
    Enable debug output for the MyOs process timer module.

config MYOS_DEBUG_CORE
  bool "Debug: core MyOs scheduler"
  depends on MYOS_DEBUG
  default n
  help
    Enable debug output for the MyOs cooperative scheduler core. 
        

config MYOS_DEBUG_TIMESTAMP
  bool "Debug: timestamp module"
  depends on MYOS_DEBUG
  default n
  help
    Enable debug output for the MyOs timestamp module.  





menu "MyOs architecture options"

config MYOS_ARCH_STM32_TIM6_BACKEND
    bool "Use STM32 TIM6 as rtimer backend"
    depends on SOC_FAMILY_STM32
    depends on DT_HAS_ST_STM32_COUNTER_ENABLED
    help
      Use STM32 TIM6 (via Zephyr counter driver) as the free-running
      hardware timer for MyOs rtimer.

endmenu



endif # MYOS
```
